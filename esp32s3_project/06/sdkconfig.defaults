## esp32s3_watch/sdkconfig.defaults
```kconfig
# 目标芯片：ESP32-S3
CONFIG_IDF_TARGET="esp32s3"

# N16R8：16MB Flash + 8MB Octal PSRAM
CONFIG_ESPTOOLPY_FLASHSIZE_16MB=y
CONFIG_SPIRAM=y
CONFIG_SPIRAM_MODE_OCT=y

# 日志同时输出到 UART 和 USB 串口/JTAG
CONFIG_ESP_CONSOLE_SECONDARY_USB_SERIAL_JTAG=y

# 分区表：OTA 用的 A/B 双槽（见根目录 partitions.csv）
CONFIG_PARTITION_TABLE_CUSTOM=y
CONFIG_PARTITION_TABLE_CUSTOM_FILENAME="partitions.csv"

# OTA：允许 http（开发用；正式产品应该用 https）+ 回滚保护
CONFIG_BOOTLOADER_APP_ROLLBACK_ENABLE=y
CONFIG_ESP_HTTPS_OTA_ALLOW_HTTP=y
CONFIG_WATCH_OTA_URL="http://192.168.1.174:8000/esp32s3_watch.bin"

# 蓝牙：只用 NimBLE（体积小），BLE 5；MTU 开大（蓝牙传固件才快）
CONFIG_BT_ENABLED=y
CONFIG_BT_NIMBLE_ENABLED=y
CONFIG_BT_NIMBLE_ATT_PREFERRED_MTU=512
CONFIG_BT_NIMBLE_50_FEATURE_SUPPORT=y

# 蓝牙缓冲池调大：传固件时数据包来得密，缓冲小了会丢包
# （之前踩过"ACL buf alloc failed"然后断连的坑）
CONFIG_BT_NIMBLE_MSYS_1_BLOCK_COUNT=32
CONFIG_BT_NIMBLE_TRANSPORT_ACL_FROM_LL_COUNT=48

# WiFi 对时（★ 真实账号密码只写在本地 sdkconfig 里，不要提交到仓库）
# 换机器后：idf.py menuconfig -> Watch 手表配置，填你所在地的 WiFi
CONFIG_WATCH_WIFI_SSID="your-wifi"
CONFIG_WATCH_WIFI_PASSWORD="your-password"

# LVGL 需要的大号字体（表盘数字用）
CONFIG_LV_FONT_MONTSERRAT_20=y
CONFIG_LV_FONT_MONTSERRAT_28=y
CONFIG_LV_FONT_MONTSERRAT_48=y

# 屏幕刷新周期：33ms(默认,约30fps) -> 16ms(约60fps)，动画更顺滑
CONFIG_LV_DEF_REFR_PERIOD=16

# LVGL 自带的示例/演示不编译（占几百 KB，项目用不到）——固件瘦身，蓝牙升级更快
CONFIG_LV_BUILD_EXAMPLES=n
CONFIG_LV_BUILD_DEMOS=n
```

## watch/esp32s3_watch/sdkconfig.defaults
```kconfig
# 目标芯片：ESP32-S3
CONFIG_IDF_TARGET="esp32s3"

# N16R8：16MB Flash + 8MB Octal PSRAM
CONFIG_ESPTOOLPY_FLASHSIZE_16MB=y
CONFIG_SPIRAM=y
CONFIG_SPIRAM_MODE_OCT=y

# 日志同时输出到 UART 和 USB 串口/JTAG
CONFIG_ESP_CONSOLE_SECONDARY_USB_SERIAL_JTAG=y

# 分区表：OTA 用的 A/B 双槽（见根目录 partitions.csv）
CONFIG_PARTITION_TABLE_CUSTOM=y
CONFIG_PARTITION_TABLE_CUSTOM_FILENAME="partitions.csv"

# OTA：允许 http（开发用；正式产品应该用 https）+ 回滚保护
CONFIG_BOOTLOADER_APP_ROLLBACK_ENABLE=y
CONFIG_ESP_HTTPS_OTA_ALLOW_HTTP=y
CONFIG_WATCH_OTA_URL="http://192.168.1.174:8000/esp32s3_watch.bin"

# 蓝牙：只用 NimBLE（体积小），BLE 5；MTU 开大（蓝牙传固件才快）
CONFIG_BT_ENABLED=y
CONFIG_BT_NIMBLE_ENABLED=y
CONFIG_BT_NIMBLE_ATT_PREFERRED_MTU=512
CONFIG_BT_NIMBLE_50_FEATURE_SUPPORT=y

# 蓝牙缓冲池调大：传固件时数据包来得密，缓冲小了会丢包
# （之前踩过"ACL buf alloc failed"然后断连的坑）
CONFIG_BT_NIMBLE_MSYS_1_BLOCK_COUNT=32
CONFIG_BT_NIMBLE_TRANSPORT_ACL_FROM_LL_COUNT=48

# WiFi 对时：这里留空，各台电脑用 idf.py menuconfig -> Watch 手表配置 填自己的 WiFi
# （真实密码只保存在本机 sdkconfig 里，sdkconfig 已加入 .gitignore，不会上传）
CONFIG_WATCH_WIFI_SSID=""
CONFIG_WATCH_WIFI_PASSWORD=""

# LVGL 需要的大号字体（表盘数字用）
CONFIG_LV_FONT_MONTSERRAT_20=y
CONFIG_LV_FONT_MONTSERRAT_28=y
CONFIG_LV_FONT_MONTSERRAT_48=y

# 屏幕刷新周期：33ms(默认,约30fps) -> 16ms(约60fps)，动画更顺滑
CONFIG_LV_DEF_REFR_PERIOD=16
```

## 手表项目/esp32s3_watch/main/Kconfig.projbuild
```kconfig
menu "Watch 手表配置"

    config WATCH_WIFI_SSID
        string "WiFi 名称 (SSID，必须是 2.4G 频段)"
        default ""
        help
            手表开机后连这个 WiFi，用 NTP 把时间对成"实时时间"（表盘显示）。
            留空 = 不联网：表盘用固件编译时间兜底，也能跑，只是时间不精确。

    config WATCH_WIFI_PASSWORD
        string "WiFi 密码"
        default ""
        help
            没有密码（开放网络）就留空。

    config WATCH_NTP_SERVER
        string "NTP 服务器"
        default "ntp.aliyun.com"
        help
            默认用阿里云的 NTP，国内比较快。
            连不上可以换成 cn.pool.ntp.org 或 pool.ntp.org。

    config WATCH_OTA_URL
        string "OTA 固件下载地址"
        default "http://192.168.1.174:8000/esp32s3_watch.bin"
        help
            手表从哪儿下载新固件（开发用 http 即可，正式产品应该用 https）。
            做法：电脑上 cd 到放固件的目录，跑 python -m http.server 8000，
            然后把 IP 换成你电脑的局域网 IP（cmd 里 ipconfig 查）。

endmenu
```
